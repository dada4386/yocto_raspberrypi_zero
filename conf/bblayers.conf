## conf/bblayers.conf
```bitbake
# POKY_BBLAYERS_CONF_VERSION is increased each time build/conf/bblayers.conf
# changes incompatibly
POKY_BBLAYERS_CONF_VERSION = "2"

BBPATH = "${TOPDIR}"
BBFILES ?= ""

BBLAYERS ?= " \
  /mnt/c/linux_home/yocto/poky/meta \
  /mnt/c/linux_home/yocto/poky/meta-poky \
  /mnt/c/linux_home/yocto/poky/meta-yocto-bsp \
  /mnt/c/linux_home/yocto/poky/meta-openembedded/meta-oe \
  /mnt/c/linux_home/yocto/poky/meta-openembedded/meta-networking \
  /mnt/c/linux_home/yocto/poky/meta-openembedded/meta-perl \
  /mnt/c/linux_home/yocto/poky/meta-openembedded/meta-python \
  /mnt/c/linux_home/yocto/poky/meta-raspberrypi \
  "
```

## conf/local.conf
```bitbake
MACHINE ??= "raspberrypi0-wifi"

DISTRO ?= "poky"

# raspberri pi default
DISTRO_FEATURES_append = " bluez5"
COMBINED_FEATURES_append = " wifi bluetooth alsa ext2"

PACKAGE_CLASSES ?= "package_rpm"
EXTRA_IMAGE_FEATURES ?= "debug-tweaks"

USER_CLASSES ?= "buildstats image-mklibs image-prelink"
PATCHRESOLVE = "noop"

BB_DISKMON_DIRS ??= "\
    STOPTASKS,${TMPDIR},1G,100K \
    STOPTASKS,${DL_DIR},1G,100K \
    STOPTASKS,${SSTATE_DIR},1G,100K \
    STOPTASKS,/tmp,100M,100K \
    ABORT,${TMPDIR},100M,1K \
    ABORT,${DL_DIR},100M,1K \
    ABORT,${SSTATE_DIR},100M,1K \
    ABORT,/tmp,10M,1K"

PACKAGECONFIG_append_pn-qemu-native = " sdl"
PACKAGECONFIG_append_pn-nativesdk-qemu = " sdl"

# core
BB_NUMBER_THREADS = "12"
PARALLEL_MAKE = "-j 12"

CONF_VERSION = "1"
#IMAGE_INSTALL_append = " linux-firmware-bcm43430 connman connman-client pulseaudio pulseaudio-server usbutils sudo wiringpi"
IMAGE_INSTALL_append = " linux-firmware-rpidistro-bcm43430 usbutils sudo wiringpi wpa-supplicant"
IMAGE_FEATURES_append = " ssh-server-dropbear"

# user setting
INHERIT_append = " extrausers"
EXTRA_USERS_PARAMS = "useradd -P devuser devuser; usermod -P root root;"

# use systemd
DISTRO_FEATURES_append += " systemd"
VIRTUAL-RUNTIME_init_manager = "systemd"
DISTRO_FEATURES_BACKFILL_CONSIDERED = "sysvinit"
VIRTUAL-RUNTIME_initscripts = ""
IMX_DEFAULT_DISTRO_FEATURES_append = " systemd"
```

## meta-raspberrypi-append/conf/layer.conf
```bitbake
# We have a conf and classes directory, add to BBPATH
BBPATH .= ":${LAYERDIR}"

# We have recipes-* directories, add to BBFILES
BBFILES += "${LAYERDIR}/recipes-*/*/*.bb \
            ${LAYERDIR}/recipes-*/*/*.bbappend"

BBFILE_COLLECTIONS += "meta-raspberrypi-append"
BBFILE_PATTERN_meta-raspberrypi-append = "^${LAYERDIR}/"
BBFILE_PRIORITY_meta-raspberrypi-append = "6"

LAYERDEPENDS_meta-raspberrypi-append = "core"
LAYERSERIES_COMPAT_meta-raspberrypi-append = "thud"
```
